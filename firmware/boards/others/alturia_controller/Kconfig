## firmware/boards/others/alturia_controller/Kconfig
```kconfig
# SPDX-License-Identifier: GPL-3.0-only

config HEAP_MEM_POOL_ADD_SIZE_BOARD
	int
	default 4096 if BOARD_ALTURIA_CONTROLLER_ESP32S3_PROCPU
```

## firmware/boards/others/alturia_controller/Kconfig.alturia_controller
```kconfig
# SPDX-License-Identifier: GPL-3.0-only

config BOARD_ALTURIA_CONTROLLER
	select SOC_ESP32S3
	select SOC_ESP32S3_PROCPU if BOARD_ALTURIA_CONTROLLER_ESP32S3_PROCPU
```

## firmware/boards/others/alturia_controller/alturia_controller_procpu_defconfig
```kconfig
# SPDX-License-Identifier: GPL-3.0-only

CONFIG_CLOCK_CONTROL=y
CONFIG_CONSOLE=y
CONFIG_GPIO=y
CONFIG_SERIAL=y
CONFIG_UART_CONSOLE=y
```

## firmware/boards/others/alturia_controller/board.yml
```yaml
board:
  name: alturia_controller
  full_name: Alturia Launch Control controller
  vendor: others
  revision:
    format: letter
    default: "A"
    revisions:
      - name: "A"
  socs:
    - name: esp32s3
```

## firmware/boards/others/alturia_satellite/Kconfig.alturia_satellite
```kconfig
# SPDX-License-Identifier: GPL-3.0-only

config BOARD_ALTURIA_SATELLITE
	select SOC_STM32G474XX
```

## firmware/boards/others/alturia_satellite/alturia_satellite_stm32g474xx_defconfig
```kconfig
# SPDX-License-Identifier: GPL-3.0-only

CONFIG_GPIO=y

# Enable MPU
CONFIG_ARM_MPU=y

# Enable HW stack protection
CONFIG_HW_STACK_PROTECTION=y
```

## firmware/boards/others/alturia_satellite/board.yml
```yaml
board:
  name: alturia_satellite
  full_name: Alturia Launch Control satellite
  vendor: others
  revision:
    format: letter
    default: "A"
    revisions:
      - name: "A"
  socs:
    - name: stm32g474xx
```

## firmware/common/link/Kconfig
```kconfig
# SPDX-License-Identifier: GPL-3.0-only
#
# Channel access for the controller <-> satellite link: the controller's
# poll cycle, the satellites' reply slots, listen-before-talk and the link
# timeouts. See design/radio_security.md, "Channel access". rsource this
# from an app's Kconfig.

menu "Link channel access"

config LINK_SAT_SAFE_TIMEOUT_MS
	int "Satellite: go SAFE after this long without an addressed poll"
	default 4000
	help
	  The satellite application disarms every channel when no poll
	  addressed to it has arrived for this long. The session is kept, so
	  the next poll brings it back without a new join.

config LINK_CTRL_PEER_TIMEOUT_MS
	int "Controller: drop a satellite's session after this long without a reply"
	default 8000
	help
	  The controller stops addressing a satellite whose session it has
	  dropped, so the satellite times out too, and then joins again.

config LINK_SAT_SESSION_TIMEOUT_MS
	int "Satellite: drop the session after this long without an addressed poll"
	default 10000
	help
	  After this the satellite forgets its session keys and sends HELLO
	  until the controller joins it again. Keep it above
	  LINK_CTRL_PEER_TIMEOUT_MS.

config LINK_TURNAROUND_MS
	int "Time from the end of a poll to the start of the first reply slot"
	default 6
	help
	  Covers the satellite decrypting the poll and building its reply,
	  and both radios switching direction.

config LINK_SLOT_GUARD_MS
	int "Guard time added to every reply slot"
	default 6
	help
	  Absorbs timing jitter between satellites and the listen-before-talk
	  at the start of each slot.

config LINK_LBT
	bool "Carrier sense before talk (CSMA/CA)"
	default y
	help
	  Sense the channel before transmitting, after a random backoff out
	  of a contention window that grows with the channel utilization
	  (the way Meshtastic does it). Turn off to compare with plain
	  scheduled access on the bench.

if LINK_LBT

config LINK_LBT_LISTEN_US
	int "How long each carrier sense samples the channel, in microseconds"
	default 1000

config LINK_LBT_MARGIN_DB
	int "Busy threshold above the measured noise floor, in dB"
	default 10

config LINK_LBT_MAX_DEFER_MS
	int "Controller: transmit anyway after deferring this long, in ms"
	default 50
	help
	  A poll carries SAFE and FIRE, so the controller never waits on
	  someone else's traffic for longer than this, beyond its contention
	  window.

config LINK_CSMA_SLOT_US
	int "CSMA slot: the backoff unit, about one carrier sense, in microseconds"
	default 1000

config LINK_CSMA_CTRL_CW_MIN
	int "Controller: contention window exponent on an idle channel"
	default 3
	range 0 10
	help
	  The backoff before each controller frame is 0 to 2^cw - 1 slots.
	  cw runs linearly from this minimum on an idle channel to
	  LINK_CSMA_CTRL_CW_MAX on a fully busy one.

config LINK_CSMA_CTRL_CW_MAX
	int "Controller: contention window exponent on a busy channel"
	default 7
	range 0 10

config LINK_CSMA_SAT_CW_MIN
	int "Satellite: contention window exponent for HELLO and PAIR_ADV, idle channel"
	default 4
	range 0 10

config LINK_CSMA_SAT_CW_MAX
	int "Satellite: contention window exponent for HELLO and PAIR_ADV, busy channel"
	default 8
	range 0 10

endif # LINK_LBT

config LINK_UTIL_WINDOW_S
	int "Channel utilization is measured over this many seconds"
	default 10
	range 2 60

config LINK_REPLY_CSMA
	bool "Experiment: satellites contend for the reply window instead of rank slots"
	depends on LINK_LBT
	help
	  Each addressed satellite answers a poll anywhere in the poll's
	  reply window (as many slots as satellites addressed), after a
	  CSMA/CA backoff, instead of in the slot of its rank. This is what
	  the link would look like without slots; compare in radiosim.

config LINK_FOREIGN
	bool "Controller: track other networks on the channel"
	default n
	help
	  The controller learns when other controllers' networks are on the
	  air from the clear headers of their frames (link_foreign_* in
	  link_sched.c), and uses that to hold its frames for a gap, to take
	  turns with them (the DESYNC poll phase), to reserve their cycles
	  for at least as long as its own, and to count them for the display.
	  Off, the controller relies on CSMA/CA alone, as Meshtastic does.

if LINK_FOREIGN

config LINK_FOREIGN_HOLD
	bool "Controller: hold frames for other networks' predicted cycles"
	default y
	help
	  Turn off to see whether CSMA/CA and the poll phase placement are
	  enough without holding each frame for a gap (link_foreign_start()).

config LINK_FOREIGN_MAX_WAIT_MS
	int "Controller: wait at most this long for another network's cycle, in ms"
	default 400
	help
	  The controller estimates when other controllers' networks are on
	  the air (their polls and replies) and holds its own frames until
	  they fit in a gap. It never holds one longer than this; commands
	  are acknowledged and repeated anyway.

endif # LINK_FOREIGN

endmenu

config RADIO_SIM
	bool "Simulated LoRa radio (radio network simulator)"
	default y
	depends on ARCH_POSIX
	help
	  On native_sim, apps that build the LoRa transport (LSEC_RADIO) get
	  common/lora/radio_sim.c in place of radio.c: frames go over UDP
	  to the radio network simulator in tools/radiosim, which relays
	  them between node instances.

config RADIO_SIM_TX_DELAY_US
	int "Simulated radio: delay from radio_send() to the frame going on air"
	default 0
	depends on RADIO_SIM
	help
	  The setup time of a real transceiver before its preamble starts.
```
